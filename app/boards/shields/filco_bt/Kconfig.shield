## boards/shields/filco_bt/Kconfig.defconfig
```kconfig
if SHIELD_FILCO_BT

config ZMK_KEYBOARD_NAME
    default "Filco Bluetooth"

config ZMK_SPLIT_BLE_ROLE_CENTRAL
    default y

endif
```

## config/dts/bindings/microchip,mcp230xx.yaml
```yaml
description: MCP230xx I2C-based GPIO expander

compatible: "microchip,mcp230xx"

include: [gpio-controller.yaml, i2c-device.yaml]

properties:
  reg:
    required: true
  label:
    type: string
  "#gpio-cells":
    const: 2
  ngpios:
    type: int
    required: true
    const: 16

gpio-cells:
  - pin
  - flags
```
