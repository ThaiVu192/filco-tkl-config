/dts-v1/;
/plugin/;

/ {
    chosen {
        zmk,kscan = &kscan0;
    };
    
    kscan0: kscan {
        compatible = "zmk,kscan-gpio-matrix";
        label = "KSCAN";
        diode-direction = "col2row";
        
        row-gpios = <
            &gpio0 8  (GPIO_ACTIVE_HIGH | GPIO_PULL_DOWN)
            &gpio0 6  (GPIO_ACTIVE_HIGH | GPIO_PULL_DOWN)
            &gpio0 17 (GPIO_ACTIVE_HIGH | GPIO_PULL_DOWN)
            &gpio0 20 (GPIO_ACTIVE_HIGH | GPIO_PULL_DOWN)
            &gpio0 22 (GPIO_ACTIVE_HIGH | GPIO_PULL_DOWN)
            &gpio0 24 (GPIO_ACTIVE_HIGH | GPIO_PULL_DOWN)
        >;
        
        col-gpios = <
            &gpio0 9  GPIO_ACTIVE_HIGH
            &gpio0 10 GPIO_ACTIVE_HIGH
            &gpio0 11 GPIO_ACTIVE_HIGH
            &gpio0 12 GPIO_ACTIVE_HIGH
            &gpio0 13 GPIO_ACTIVE_HIGH
            &gpio0 14 GPIO_ACTIVE_HIGH
            &gpio0 15 GPIO_ACTIVE_HIGH
            &gpio0 16 GPIO_ACTIVE_HIGH
            &gpio0 17 GPIO_ACTIVE_HIGH
            &gpio0 18 GPIO_ACTIVE_HIGH
            &gpio0 19 GPIO_ACTIVE_HIGH
            &gpio0 20 GPIO_ACTIVE_HIGH
            &gpio0 21 GPIO_ACTIVE_HIGH
            &gpio0 22 GPIO_ACTIVE_HIGH
            &gpio0 23 GPIO_ACTIVE_HIGH
            &gpio0 24 GPIO_ACTIVE_HIGH
            &gpio1 0  GPIO_ACTIVE_HIGH
        >;
    };
};